/* SPDX-License-Identifier: GPL-2.0-or-later */
#include "../../config/halcyon_elora.keymap"
#include <dt-bindings/zmk/kscan_mock.h>

&kscan {
    rows = <1>;
    columns = <72>;
    events = <
        ZMK_MOCK_PRESS(0,44,10)
        ZMK_MOCK_RELEASE(0,44,10)
        /* Normal plateau: 2000 units/sec, 32 units per 16ms tick. */
        ZMK_MOCK_PRESS(0,33,400)
        ZMK_MOCK_RELEASE(0,33,250)
        /* Hold/release Fast while an arrow remains physically held. */
        ZMK_MOCK_PRESS(0,33,400)
        ZMK_MOCK_PRESS(0,60,250)
        ZMK_MOCK_RELEASE(0,60,120)
        ZMK_MOCK_RELEASE(0,33,250)
        /* Precision hold returns to normal on release. */
        ZMK_MOCK_PRESS(0,61,220)
        ZMK_MOCK_PRESS(0,33,400)
        ZMK_MOCK_RELEASE(0,33,10)
        ZMK_MOCK_RELEASE(0,61,250)
        /* Double-tap Fast on, move after key-up, double-tap off. */
        ZMK_MOCK_PRESS(0,60,20)
        ZMK_MOCK_RELEASE(0,60,20)
        ZMK_MOCK_PRESS(0,60,20)
        ZMK_MOCK_RELEASE(0,60,250)
        ZMK_MOCK_PRESS(0,33,400)
        ZMK_MOCK_RELEASE(0,33,10)
        ZMK_MOCK_PRESS(0,60,20)
        ZMK_MOCK_RELEASE(0,60,20)
        ZMK_MOCK_PRESS(0,60,20)
        ZMK_MOCK_RELEASE(0,60,250)
        ZMK_MOCK_PRESS(0,33,400)
        ZMK_MOCK_RELEASE(0,33,250)
        /* Double-tap Precision on/off behaves the same way. */
        ZMK_MOCK_PRESS(0,61,20)
        ZMK_MOCK_RELEASE(0,61,20)
        ZMK_MOCK_PRESS(0,61,20)
        ZMK_MOCK_RELEASE(0,61,250)
        ZMK_MOCK_PRESS(0,33,400)
        ZMK_MOCK_RELEASE(0,33,10)
        ZMK_MOCK_PRESS(0,61,20)
        ZMK_MOCK_RELEASE(0,61,20)
        ZMK_MOCK_PRESS(0,61,20)
        ZMK_MOCK_RELEASE(0,61,250)
        ZMK_MOCK_PRESS(0,33,400)
        ZMK_MOCK_RELEASE(0,33,250)
        /* Precision wins when both are held; releases restore Fast, normal. */
        ZMK_MOCK_PRESS(0,60,220)
        ZMK_MOCK_PRESS(0,61,220)
        ZMK_MOCK_PRESS(0,33,400)
        ZMK_MOCK_RELEASE(0,61,120)
        ZMK_MOCK_RELEASE(0,60,120)
        ZMK_MOCK_RELEASE(0,33,250)
        /* A hold on an already-latched mode must not cancel the latch. */
        ZMK_MOCK_PRESS(0,60,20)
        ZMK_MOCK_RELEASE(0,60,20)
        ZMK_MOCK_PRESS(0,60,20)
        ZMK_MOCK_RELEASE(0,60,250)
        ZMK_MOCK_PRESS(0,60,220)
        ZMK_MOCK_RELEASE(0,60,250)
        /* Mouse-off still types, despite Fast remaining latched in RAM. */
        ZMK_MOCK_PRESS(0,44,10)
        ZMK_MOCK_RELEASE(0,44,10)
        ZMK_MOCK_PRESS(0,57,10)
        ZMK_MOCK_RELEASE(0,57,10)
        /* NUM decimal works normally, with no speed overlay to mask it. */
        ZMK_MOCK_PRESS(0,58,220)
        ZMK_MOCK_PRESS(0,52,10)
        ZMK_MOCK_RELEASE(0,52,10)
        ZMK_MOCK_PRESS(0,57,10)
        ZMK_MOCK_RELEASE(0,57,10)
        ZMK_MOCK_RELEASE(0,58,250)
        ZMK_MOCK_PRESS(0,44,10)
        ZMK_MOCK_RELEASE(0,44,10)
        ZMK_MOCK_PRESS(0,33,400)
        ZMK_MOCK_RELEASE(0,33,10)
        ZMK_MOCK_PRESS(0,60,20)
        ZMK_MOCK_RELEASE(0,60,20)
        ZMK_MOCK_PRESS(0,60,20)
        ZMK_MOCK_RELEASE(0,60,250)
        /* Release routing must still clear a held mode after Mouse-off. */
        ZMK_MOCK_PRESS(0,61,220)
        ZMK_MOCK_PRESS(0,44,10)
        ZMK_MOCK_RELEASE(0,44,10)
        ZMK_MOCK_RELEASE(0,61,250)
        ZMK_MOCK_PRESS(0,57,10)
        ZMK_MOCK_RELEASE(0,57,10)
    >;
};
