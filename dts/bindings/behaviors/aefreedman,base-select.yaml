## dts/bindings/behaviors/aefreedman,base-select.yaml
```yaml
description: Select a base layout without clearing overlay layers
compatible: "aefreedman,base-select"
include: one_param.yaml
```

## dts/bindings/behaviors/aefreedman,mouse-speed.yaml
```yaml
description: Runtime speed control (0 down, 1 up, 2 reset, 3/4 Fast hold/toggle, 5/6 Precision hold/toggle)
compatible: "aefreedman,mouse-speed"
include: one_param.yaml
```

## dts/bindings/behaviors/aefreedman,reviung-base.yaml
```yaml
description: Select a Reviung base layout without clearing overlay layers
compatible: "aefreedman,reviung-base"
include: one_param.yaml
```

## dts/bindings/behaviors/aefreedman,reviung-dance.yaml
```yaml
description: Reviung tap dances with keycode-aware rollover and shared one-shot state
compatible: "aefreedman,reviung-dance"
include: one_param.yaml
properties:
  symbol-layer:
    type: int
    required: true
```

## dts/bindings/behaviors/aefreedman,thumb-gestures.yaml
```yaml
description: Thumb gestures with keycode-aware rollover and shared one-shot state
compatible: "aefreedman,thumb-gestures"
include: one_param.yaml
properties:
  symbol-layer:
    type: int
    required: true
```

## dts/bindings/input_processors/aefreedman,mouse-speed-scaler.yaml
```yaml
description: Scale pointer X/Y by runtime normal or fixed Fast/Precision speed relative to 2000
compatible: "aefreedman,mouse-speed-scaler"
include: ip_zero_param.yaml
```
